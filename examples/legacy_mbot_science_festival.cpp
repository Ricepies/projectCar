/**
 * @file legacy_mbot_science_festival.cpp
 * @brief Legacy 2021 Science Festival mBot Arduino sketch with MePS2 and RGB LED effects.
 *
 * Generated by mBlock5 for mBot.
 * Originally rewritten by students of Beijing Bayi School Attached Yuquan Middle School (Class 1, 2023)
 * for the 2021 Science Festival.
 */

#if defined(ARDUINO_AVR_UNO) || defined(__AVR__)

#include <MePS2.h>
#include <MeMCore.h>
#include <Arduino.h>
#include <Wire.h>
#include <SoftwareSerial.h>

MeDCMotor motor_9(9);
MeDCMotor motor_10(10);
MeRGBLed rgbled_7(7, 2);

MePS2 MePS2(PORT_5);

bool is_flashing = false;

#define FLASH_NOW_IF(ms, r, g, b)      \
    if (now_time - start_time < ms)    \
    {                                  \
        rgbled_7.setColor(0, r, g, b); \
        rgbled_7.show();               \
        return;                        \
    }

void flash_rainbow_lights(unsigned long start_time, unsigned long now_time)
{
    FLASH_NOW_IF(200, 255, 0, 0)
    FLASH_NOW_IF(400, 255, 127, 0)
    FLASH_NOW_IF(600, 255, 255, 0)
    FLASH_NOW_IF(800, 0, 255, 0)
    FLASH_NOW_IF(1000, 0, 0, 255)
    FLASH_NOW_IF(1200, 75, 0, 130)
    FLASH_NOW_IF(1400, 148, 0, 211)
    FLASH_NOW_IF(1600, 0, 0, 0)
    is_flashing = (now_time - start_time <= 1600);
}

void _loop()
{
    MePS2.loop();
}

void setup()
{
    MePS2.begin(115200);
    rgbled_7.fillPixelsBak(0, 2, 1);
    while (1)
    {
        unsigned long start_time = 0;
        unsigned long now_time = 0;

        motor_9.run(-1 * (MePS2.MeAnalog(2) + MePS2.MeAnalog(4)) / 100.0 * 255);
        motor_10.run((MePS2.MeAnalog(4) - MePS2.MeAnalog(2)) / 100.0 * 255);

        if (MePS2.ButtonPressed(11))
        {
            is_flashing = true;
            start_time = millis();
            now_time = millis();
            flash_rainbow_lights(start_time, now_time);
        }

        if (is_flashing)
        {
            now_time = millis();
            flash_rainbow_lights(start_time, now_time);
        }
        _loop();
    }
}

void loop()
{
    _loop();
}

#endif // ARDUINO_AVR_UNO
